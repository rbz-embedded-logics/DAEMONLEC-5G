## SW/linux/rootfs/meta-rbz-targetx/conf/layer.conf
```bitbake
# We have a conf and classes directory, add to BBPATH
BBPATH .= ":${LAYERDIR}"

# We have recipes-* directories, add to BBFILES
BBFILES += "${LAYERDIR}/recipes-*/*/*.bb \
         ${LAYERDIR}/recipes-*/*/*.bbappend"

BBFILE_COLLECTIONS += "rbz-targetx"
BBFILE_PATTERN_rbz-targetx = "^${LAYERDIR}/"
BBFILE_PRIORITY_rbz-targetx = "3"
LAYERVERSION_rbz-targetx = "1"
LAYERSERIES_COMPAT_rbz-targetx = ""

PREFERRED_VERSION_libgpiod = "1.6.4"
IMAGE_INSTALL:append = " nuttcp ppp modemmanager networkmanager networkmanager-nmcli networkmanager-ppp libgpiod libgpiod-tools python3-speedtest-cli mosquitto mosquitto-clients"
IMAGE_INSTALL:remove = " connman-tools packagegroup-core-tools-testapps"
PACKAGE_EXCLUDE = "packagegroup-core-tools-testapps connman connman-client nxp-demo-experience packagegroup-qt6-imx packagegroup-core-weston"
PACKAGECONFIG:append:pn-networkmanager = " modemmanager ppp"
```
